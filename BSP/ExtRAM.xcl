// ---------------------------------------------------------
//   ATMEL Microcontroller Software Support  -  ROUSSET  -
// ---------------------------------------------------------
// The software is delivered "AS IS" without warranty or
// condition of any  kind, either express, implied or
// statutory. This includes without limitation any warranty
// or condition with respect to merchantability or fitness
// for any particular purpose, or against the infringements of
// intellectual property rights of others.
// ---------------------------------------------------------
//  File: at91SAM7x256_NoRemap.xlc
//
//
//  $Revision: 1.1.1.1 $
//
// ---------------------------------------------------------

//*************************************************************************
// XLINK command file template for EWARM/ICCARM
//
// Usage:  xlink  -f lnkarm  <your_object_file(s)>
//                -s <program start label>  <C/C++ runtime library>
//
// $Revision: 1.1.1.1 $
//*************************************************************************

//************************************************
// Inform the linker about the CPU family used.
// AT91SAM9261 Memory mapping
// NO REMAP (RCB0) = 0
//     BMS = 1:
//      0x00000000: Int. ROM
//      0x00100000: Int. RAM A
//      0x00200000: Int. RAM B
//      0x00300000: Int. RAM C
//      0x00400000: Int. ROM
//    BMS = 0:
//      0x00000000: EBI NCS0
//      0x00100000: Int. RAM A
//      0x00200000: Int. RAM B
//      0x00300000: Int. RAM C
//      0x00400000: Int. ROM
	
//WITH REMAP (RCB0) = 1
//      0x00000000: Int. RAM C
//      0x00100000: Int. RAM A
//      0x00200000: Int. RAM B
//      0x00300000: Int. RAM C
//      0x00400000: Int. ROM
	
//where...
//	RAM A: is the Instruction TCM relocatable anywhere via CP15 commands
//	RAM B: is the Data TCM relocatable anywhere via CP15 commands
//	RAM C: is available to all AHB masters and is remapable to 0x00.

//	*upon reset, all 10 16KB relocatalbe memory blocks are assigned to RAM C*
//       note: 2 are permantely assigned to RAM C.

//************************************************
-carm

//*************************************************************************
// All read only segments to external RAM (64 MB)
//*************************************************************************
-DROMSTART=20000040
-DROMEND=23FFFFFF

//*************************************************************************
// Read/write segments mapped to external RAM (64 MB)
//*************************************************************************
-DRAMSTART=20000000
-DRAMEND=23FFFFFF

//*************************************************************************
// Fast internal RAM will be used for the LCD frame buffer (160KB)
//*************************************************************************
-DINT_GUI_RAM_START=00300040
-DINT_GUI_RAM_END=00327FFF

//************************************************
// Address range for reset and exception
// vectors (INTVEC).
// The vector area is 32 bytes,
// an additional 32 bytes is allocated for the
// constant table used by ldr PC in cstartup.s79.
// Vectors must be placed in internal RAM
// when debugging the GUI app from external RAM.
// The internal RAM must be remapped to 0x00.
//************************************************
-Z(CODE)INTVEC=00300000-0030003F

//************************************************
// Startup code and exception routines (ICODE).
//************************************************
-Z(CODE)ICODE,DIFUNCT=ROMSTART-ROMEND
-Z(CONST)CODE_ID=ROMSTART-ROMEND
-QCODE_I=CODE_ID

-Z(CODE)SWITAB=ROMSTART-ROMEND

//************************************************
// Code segments may be placed anywhere.
//************************************************
-Z(CODE)CODE=ROMSTART-ROMEND

//************************************************
// Various constants and initializers.
//************************************************
-Z(CONST)INITTAB,DATA_ID,DATA_C=ROMSTART-ROMEND
-Z(CONST)CHECKSUM=ROMSTART-ROMEND


//************************************************
// Data segments.
//************************************************
-Z(DATA)DATA_I,DATA_Z,DATA_N=RAMSTART-RAMEND

//************************************************
// __ramfunc code copied to and executed from RAM.
//************************************************
-Z(DATA)CODE_I=RAMSTART-RAMEND

//************************************************
// ICCARM produces code for __ramfunc functions in
// CODE_I segments. The -Q XLINK command line
// option redirects XLINK to emit the code in the
// debug information associated with the CODE_I
// segment, where the code will execute.
//************************************************

//*************************************************************************
// Stack and heap segments.
//*************************************************************************
-D_CSTACK_SIZE=256
-D_IRQ_STACK_SIZE=256
-D_FIQ_STACK_SIZE=256
-D_SVC_STACK_SIZE=256
-D_ABT_STACK_SIZE=256
-D_UND_STACK_SIZE=256
-D_HEAP_SIZE=3FFF

-Z(DATA)CSTACK+_CSTACK_SIZE=RAMSTART-RAMEND
-Z(DATA)IRQ_STACK+_IRQ_STACK_SIZE=RAMSTART-RAMEND
-Z(DATA)FIQ_STACK+_FIQ_STACK_SIZE=RAMSTART-RAMEND
-Z(DATA)SVC_STACK+_SVC_STACK_SIZE=RAMSTART-RAMEND
-Z(DATA)ABT_STACK+_ABT_STACK_SIZE=RAMSTART-RAMEND
-Z(DATA)UND_STACK+_UND_STACK_SIZE=RAMSTART-RAMEND
-Z(DATA)HEAP+_HEAP_SIZE=RAMSTART-RAMEND

//*************************************************************************
// ELF/DWARF support.
//
// Uncomment the line "-Felf" below to generate ELF/DWARF output.
// Available format specifiers are:
//
//   "-yn": Suppress DWARF debug output
//   "-yp": Multiple ELF program sections
//   "-yas": Format suitable for debuggers from ARM Ltd (also sets -p flag)
//
// "-Felf" and the format specifiers can also be supplied directly as
// command line options, or selected from the Xlink Output tab in the
// IAR Embedded Workbench.
//*************************************************************************

// -Felf
